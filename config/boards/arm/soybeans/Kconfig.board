## config/boards/arm/soybeans/Kconfig.board
```kconfig
# Copyright (c) 2021 The ZMK Contributors
# SPDX-License-Identifier: MIT

config BOARD_SOYBEANS_V1
	bool "soybeans v1"
	depends on SOC_NRF52840_QIAA
```

## config/boards/arm/soybeans/Kconfig.defconfig
```kconfig
# Copyright (c) 2021 The ZMK Contributors
# SPDX-License-Identifier: MIT

if BOARD_SOYBEANS_V1

config BOARD
	default "Soybeans"

if USB

config USB_NRFX
	default y

config USB_DEVICE_STACK
	default y

endif # USB

if ZMK_DISPLAY

choice
   prompt "Trigger mode"
   default ZMK_DISPLAY_OLED
   help
	  Specify the type of triggering to be used by the driver.
	  
   config ZMK_DISPLAY_OLED
        depends on ZMK_DISPLAY
	select ZMK_DISPLAY_OLED_CONFIG

   config EC11_TRIGGER_OWN_THREAD
        depends on ZMK_DISPLAY
	select ZMK_DISPLAY_E_INK_CONFIG
endchoice

config EC11_THREAD_PRIORITY

    config I2C
	   default y

config SSD1306
	default y

config SSD1306_REVERSE_MODE
	default y
#LVGL
config LVGL_HOR_RES_MAX
	default 128

config LVGL_VER_RES_MAX
	default 32

config LVGL_VDB_SIZE
	default 64

config LVGL_DPI
	default 148

config LVGL_BITS_PER_PIXEL
	default 1

choice LVGL_COLOR_DEPTH
	default LVGL_COLOR_DEPTH_1
endchoice

endif # ZMK_DISPLAY_OLED

config BT_CTLR
	default BT

config ZMK_BLE
	default y

config ZMK_USB
	default y

config ZMK_BATTERY_VOLTAGE_DIVIDER
	default y

config ZMK_KEYBOARD_NAME
	default "Soybeans Rev1"

endif # BOARD_SOYBEANS_V1
```

## config/west.yml
```yaml
manifest:
  remotes:
    - name: zmkfirmware
      url-base: https://github.com/zmkfirmware
    - name: kien242
      url-base: https://github.com/kien242
  projects:
    - name: zmk
      remote: zmkfirmware
      revision: main
      import: app/west.yml
  self:
    path: config
```
